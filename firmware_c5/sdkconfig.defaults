## firmware_c5/sdkconfig.defaults
```kconfig
# Flash — 8MB, 80MHz, DIO. NO_STUB necessário para suporte ao C5 no esptool.
CONFIG_ESPTOOLPY_FLASHSIZE_8MB=y
CONFIG_ESPTOOLPY_FLASHFREQ_80M=y
CONFIG_ESPTOOLPY_FLASHMODE_DIO=y
CONFIG_ESPTOOLPY_NO_STUB=y

# Partição customizada
CONFIG_PARTITION_TABLE_CUSTOM=y
CONFIG_PARTITION_TABLE_CUSTOM_FILENAME="partitions.csv"

# CPU 240MHz (padrão do C5 é 160MHz)
CONFIG_ESP_DEFAULT_CPU_FREQ_MHZ_240=y

# Single-core — C5 é unicore, sem isso o FreeRTOS tenta inicializar o core 1
CONFIG_FREERTOS_UNICORE=y
CONFIG_ESP_SYSTEM_SINGLE_CORE_MODE=y

# PSRAM quad, 40MHz
CONFIG_SPIRAM=y
CONFIG_SPIRAM_MODE_QUAD=y
CONFIG_SPIRAM_SPEED_40M=y
CONFIG_SPIRAM_USE_MALLOC=y
CONFIG_SPIRAM_MALLOC_ALWAYSINTERNAL=16384
CONFIG_SPIRAM_MALLOC_RESERVE_INTERNAL=32768

# Stack maior para kernel_init
CONFIG_ESP_MAIN_TASK_STACK_SIZE=8192

# Console via UART0 (CH340 no devkit C5: GPIO11/12)
CONFIG_ESP_CONSOLE_UART_DEFAULT=y
CONFIG_ESP_CONSOLE_SECONDARY_NONE=y

# Bluetooth NimBLE
CONFIG_BT_ENABLED=y
CONFIG_BT_NIMBLE_ENABLED=y
CONFIG_BT_CONTROLLER_ENABLED=y

# Log INFO por padrão
CONFIG_LOG_DEFAULT_LEVEL_INFO=y
CONFIG_BOOTLOADER_LOG_VERSION_1=y

# Necessário para sys_monitor (uxTaskGetSystemState / vTaskList)
CONFIG_FREERTOS_USE_TRACE_FACILITY=y
CONFIG_FREERTOS_USE_STATS_FORMATTING_FUNCTIONS=y
```

## firmware_p4/sdkconfig.defaults
```kconfig
# Flash — 32MB, 80MHz, DIO
CONFIG_ESPTOOLPY_FLASHSIZE_32MB=y
CONFIG_ESPTOOLPY_FLASHFREQ_80M=y
CONFIG_ESPTOOLPY_FLASHMODE_DIO=y

# Partição customizada (com OTA)
CONFIG_PARTITION_TABLE_CUSTOM=y
CONFIG_PARTITION_TABLE_CUSTOM_FILENAME="partitions.csv"

# OTA rollback no bootloader
CONFIG_BOOTLOADER_APP_ROLLBACK_ENABLE=y

# CPU 360MHz (máximo do P4)
CONFIG_ESP_DEFAULT_CPU_FREQ_MHZ_360=y

# PSRAM hex-octal, 200MHz — específico do P4
CONFIG_SPIRAM=y
CONFIG_SPIRAM_MODE_HEX=y
CONFIG_SPIRAM_SPEED_200M=y
CONFIG_SPIRAM_USE_MALLOC=y
CONFIG_SPIRAM_MALLOC_ALWAYSINTERNAL=16384
CONFIG_SPIRAM_MALLOC_RESERVE_INTERNAL=32768

# Stack maior para kernel_init
CONFIG_ESP_MAIN_TASK_STACK_SIZE=8192

# Console primário UART0, secundário USB JTAG
CONFIG_ESP_CONSOLE_UART_DEFAULT=y
CONFIG_ESP_CONSOLE_SECONDARY_USB_SERIAL_JTAG=y

# TinyUSB HID — 2 interfaces (keyboard + mouse) para Bad USB
CONFIG_TINYUSB_HID_COUNT=2
CONFIG_TINYUSB_MODE_DMA=y

# Log INFO por padrão
CONFIG_LOG_DEFAULT_LEVEL_INFO=y
```
